## fs/initramfs/Config.in
```kconfig
config BR2_TARGET_ROOTFS_INITRAMFS
	bool "initial RAM filesystem linked into linux kernel"
	depends on BR2_LINUX_KERNEL
	help
	  Integrate the root filesystem generated by Buildroot as an
	  initramfs inside the kernel image. This integration will
	  take place automatically.

	  A rootfs.cpio file will be generated in the images/ directory.
	  This is the archive that will be included in the kernel image.
	  The default rootfs compression set in the kernel configuration
	  is used, regardless of how buildroot's cpio archive is
	  configured.

	  Note that enabling initramfs together with another filesystem
	  formats doesn't make sense: you would end up having two
	  identical root filesystems, one embedded inside the kernel
	  image, and one separately.

if BR2_TARGET_ROOTFS_INITRAMFS

choice
	prompt "source of initramfs"
	default BR2_TARGET_ROOTFS_INITRAMFS_CPIO
	help
	  Select the initramfs source

config BR2_TARGET_ROOTFS_INITRAMFS_CPIO
	bool "full target from cpio"
	select BR2_TARGET_ROOTFS_CPIO
	help
	  Basic CPIO initramfs

config BR2_TARGET_ROOTFS_INITRAMFS_DRACUT
	bool "cherry-pick from target with dracut"
	depends on BR2_USE_MMU # dracut -> fork()
	depends on !BR2_STATIC_LIBS # dracut -> kmod
	select BR2_TARGET_ROOTFS_DRACUT
	depends on BR2_INIT_BUSYBOX || BR2_INIT_SYSTEMD
	help
	  Create an initramfs using dracut. Dracut will create an
	  initramfs from your root filing system instead of needing
	  a seperatly built filing system dedicated as an initramfs.

comment "dracut cpio needs busybox, or systemd init system"
	depends on !BR2_INIT_BUSYBOX && !BR2_INIT_SYSTEMD

comment "dracut needs a toolchain w/ dynamic library"
	depends on BR2_USE_MMU
	depends on BR2_STATIC_LIBS

endchoice

endif

comment "initramfs needs a Linux kernel to be built"
	depends on !BR2_LINUX_KERNEL
```

## package/aardvark-dns/Config.in
```kconfig
config BR2_PACKAGE_AARDVARK_DNS
	bool "aardvark-dns"
	depends on BR2_PACKAGE_HOST_RUSTC_TARGET_ARCH_SUPPORTS
	select BR2_PACKAGE_HOST_CARGO
        help
	  Aardvark-dns is an authoritative dns server for A/AAAA 
          container records. It can forward other requests to 
          configured resolvers.
```

## package/netavark/Config.in
```kconfig
config BR2_PACKAGE_NETAVARK
	bool "netavark"
	depends on BR2_PACKAGE_HOST_RUSTC_TARGET_ARCH_SUPPORTS
#	depends on BR2_PACKAGE_PROTOBUF
	select BR2_PACKAGE_HOST_CARGO
	select BR2_PACKAGE_PROTOBUF
        help
	  Netavark is a rust based network stack for containers. 
          It is being designed to work with Podman but is also 
          applicable for other OCI container management applications.
```

## package/python-podman-compose/Config.in
```kconfig
config BR2_PACKAGE_PYTHON_PODMAN_COMPOSE
	bool "python-podman-compose"
	select BR2_PACKAGE_PYTHON_DOTENV # runtime
	select BR2_PACKAGE_PYTHON_PYYAML # runtime
	help
	  A script to run docker-compose.yml using podman.

	  https://github.com/containers/podman-compose
```
